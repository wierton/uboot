## arch/mips/mach-njuoop/Kconfig
```kconfig
menu "NJUOOP platforms"
    depends on MACH_NJUOOP

choice
    prompt "Board select"

config TARGET_NEMU_MIPS32
    bool "NEMU-mips32 architecture"

config TARGET_NJUOOP_NPC
    bool "FPGA-zedboard board used in loongson cup"

endchoice

source "board/njuoop/Kconfig"

endmenu
```

## board/njuoop/Kconfig
```kconfig
if TARGET_NEMU_MIPS32 || TARGET_NJUOOP_NPC

config SYS_BOARD
    default "FPGA-zedboard"

config SYS_VENDOR
    default "njuoop"

config SYS_CONFIG_NAME
    default "mips32_njuoop"

config SYS_TEXT_BASE
    default 0xbfc00000

endif
```
